## main/Kconfig.projbuild
```kconfig
menu "Example Configuration"
 
    config PIN_NUM_MOSI
        int "MOSI pin"
        range 0 48
        default 23
        help
            MOSI pin
 
    config PIN_NUM_CLK
        int "CLK pin"
        range 0 48
        default 18
        help
            CLK pin
 
    config PIN_NUM_CS
        int "CS pin"
        range 0 48
        default -1
        help
            CS pin
            
	config PIN_NUM_RESET
        int "RESET pin"
        range 0 48
        default 33
        help
            RESET pin
 
    config PIN_NUM_DC
        int "DC pin"
        range 0 48
        default 27
        help
            DC pin
 
    config PIN_NUM_BLK
        int "BLK pin"
        range 0 48
        default -1
        help
            BLK pin     
            
endmenu
```
